## conf/machine/up-xtreme-arl-rt.conf
```bitbake
#@TYPE: Machine
#@NAME: up-xtreme-arl-rt

#@DESCRIPTION: RT kernel variant for AAEON UP Xtreme ARL (UPX-ARL01)

PREFERRED_PROVIDER_virtual/kernel ?= "linux-intel-rt"
PREFERRED_VERSION_linux-intel-rt ?= "6.18%"

require conf/machine/include/up-common.inc

ACPI_TABLES ?= "upxtreme-arl-spidev1.0.asl upxtreme-arl-spidev1.1.asl"
INITRD_LIVE:prepend = "${DEPLOY_DIR_IMAGE}/acpi-tables.cpio "
EXTRA_IMAGEDEPENDS:append = " acpi-tables"

IMAGE_INSTALL:append = " npu-firmware linux-firmware"
IMAGE_INSTALL:append = " linux-firmware-intel-ipu6-isys"

APPEND:append = " console=tty0"

BAD_RECOMMENDATIONS:append = " linux-firmware-intel-vpu linux-firmware-intel-vpu-license"
```
